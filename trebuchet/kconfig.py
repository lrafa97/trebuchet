## trebuchet/kconfig.py
```kconfig
"""Read what a Klipper/Katapult `.config` says, so the user never has to type it again.

menuconfig already asks for the MCU, the communication interface and the CAN speed.
Instead of asking a second time, we read the resulting `.config`.

Symbols were checked against the Klipper and Katapult Kconfig files and against `.config`
files generated by their own build system (see tests/fixtures/kconfig):

    CONFIG_MCU="stm32g0b1xx"          MCU the firmware is built for (also what the running
                                      firmware reports: USB product name, Moonraker)
    CONFIG_USBCANBUS=y                USB to CAN bridge
    CONFIG_CANSERIAL=y                CAN node (talks to the host over CAN)
    CONFIG_USBSERIAL=y                USB serial
    CONFIG_SERIAL=y                   hardware UART
    CONFIG_CANBUS_FREQUENCY=500000    only meaningful when CONFIG_CANBUS=y
    CONFIG_FLASH_APPLICATION_ADDRESS  where Klipper starts (bootloader offset)
    CONFIG_LAUNCH_APP_ADDRESS         where Katapult jumps to; must equal the Klipper address
"""
from __future__ import annotations

import re
from dataclasses import dataclass
from pathlib import Path
from typing import Optional

from . import discover

_LINE = re.compile(r'^CONFIG_(?P<key>[A-Za-z0-9_]+)=(?P<val>.*)$')


@dataclass
class FirmwareConfig:
    mcu: str = ""                       # e.g. stm32g0b1xx
    interface: str = ""                 # usb | can | usb-can-bridge | uart | ""
    can_bitrate: Optional[int] = None
    app_address: Optional[int] = None   # Klipper: FLASH_APPLICATION_ADDRESS, Katapult: LAUNCH_APP_ADDRESS

    @property
    def family(self) -> str:
        m = self.mcu.lower()
        if m.startswith("stm32"):
            return "stm32"
        if m.startswith("rp2040"):
            return "rp2040"
        return "other"

    @property
    def mcu_core(self) -> str:
        """stm32g0b1xx -> stm32g0b1 (same form the profiles use)."""
        return discover.chip_core(self.mcu)


def _read(path: Path) -> dict:
    values: dict[str, str] = {}
    try:
        text = path.read_text(encoding="utf-8", errors="replace")
    except OSError:
        return values
    for line in text.splitlines():
        m = _LINE.match(line.strip())
        if m:
            values[m.group("key")] = m.group("val").strip()
    return values


def _truthy(values: dict, key: str) -> bool:
    return values.get(key) == "y"


def _int(text: str) -> Optional[int]:
    try:
        return int(text, 0)
    except (TypeError, ValueError):
        return None


def parse_config(path: Path, kind: str = "klipper") -> Optional[FirmwareConfig]:
    """None if the file does not exist or has no MCU (not a Klipper/Katapult .config)."""
    values = _read(path)
    mcu = values.get("MCU", "").strip('"')
    if not mcu:
        return None
    if _truthy(values, "USBCANBUS"):
        interface = "usb-can-bridge"
    elif _truthy(values, "CANSERIAL"):
        interface = "can"
    elif _truthy(values, "USBSERIAL"):
        interface = "usb"
    elif _truthy(values, "SERIAL"):
        interface = "uart"
    else:
        interface = ""
    bitrate = _int(values.get("CANBUS_FREQUENCY", "")) if _truthy(values, "CANBUS") else None
    addr_key = "LAUNCH_APP_ADDRESS" if kind == "katapult" else "FLASH_APPLICATION_ADDRESS"
    return FirmwareConfig(mcu=mcu, interface=interface, can_bitrate=bitrate,
                          app_address=_int(values.get(addr_key, "")))


def check_against_profile(cfg: FirmwareConfig, *, family: str, mcu: str, interface: str,
                          can_bitrate: Optional[int]) -> list[str]:
    """Contradictions between a `.config` and the profile that uses it."""
    out: list[str] = []
    if cfg.mcu_core and discover.chip_core(mcu) and cfg.mcu_core != discover.chip_core(mcu):
        out.append(f"the .config is built for {cfg.mcu} but the profile says {mcu}")
    if cfg.interface and cfg.interface != interface:
        out.append(f"the .config makes the board talk over '{cfg.interface}' but the profile "
                   f"says '{interface}'")
    if interface in ("can", "usb-can-bridge") and cfg.interface in ("can", "usb-can-bridge") \
            and can_bitrate and cfg.can_bitrate and cfg.can_bitrate != can_bitrate:
        out.append(f"the .config uses CAN speed {cfg.can_bitrate} but the profile says {can_bitrate}")
    return out


def check_offsets(klipper: Optional[FirmwareConfig], katapult: Optional[FirmwareConfig]) -> Optional[str]:
    """Katapult jumps to LAUNCH_APP_ADDRESS; Klipper must be linked to start there."""
    if not klipper or not katapult:
        return None
    if klipper.app_address is None or katapult.app_address is None:
        return None
    if klipper.app_address != katapult.app_address:
        return (f"Klipper starts at {klipper.app_address:#x} but Katapult jumps to "
                f"{katapult.app_address:#x}. Use the same bootloader offset in both menuconfigs, "
                "otherwise the board will not boot Klipper.")
    return None
```
